## Kconfig.projbuild
```kconfig
menu "WiFi Config"

    config WIFI_CFG_MAX_NETWORKS
        int "Maximum saved networks"
        default 5
        help
            Maximum number of WiFi networks that can be saved in NVS.

    config WIFI_CFG_MAX_VARS
        int "Maximum custom variables"
        default 10
        help
            Maximum number of custom variables that can be saved.

    config WIFI_CFG_DEFAULT_RETRY
        int "Default retry per network"
        default 3
        help
            Number of connection retries per network before trying the next one.

    config WIFI_CFG_RETRY_INTERVAL_MS
        int "Retry interval (ms)"
        default 5000
        help
            Interval between connection retries in milliseconds.

    config WIFI_CFG_MAX_SCAN_RESULTS
        int "Maximum scan results returned"
        default 20
        help
            Maximum number of WiFi scan results returned by the scan API.

    config WIFI_CFG_HTTP_MAX_CONTENT_LEN
        int "HTTP max request body size"
        default 2048
        help
            Maximum allowed size (bytes) for HTTP request bodies (JSON payloads).

    config WIFI_CFG_TASK_STACK_SIZE
        int "Manager task stack size"
        default 4096
        help
            Stack size (bytes) for the WiFi Config FreeRTOS task.

    config WIFI_CFG_TASK_PRIORITY
        int "Manager task priority"
        default 5
        help
            FreeRTOS priority for the WiFi Config task and DNS server task.

    config WIFI_CFG_HTTP_MAX_URI_HANDLERS
        int "Max HTTP URI handlers"
        default 32
        help
            Maximum number of URI handlers registered with the HTTP server.
            Default accounts for API(18) + WebUI(3) + Captive(8) + reserve.

    config WIFI_CFG_ENABLE_CLI
        bool "Enable CLI interface"
        default n
        help
            Enable command-line interface for WiFi Config.
            Requires ESP Console component.

            Commands: wifi_status, wifi_scan, wifi_list, wifi_add,
            wifi_del, wifi_connect, wifi_disconnect, wifi_ap_start,
            wifi_ap_stop, wifi_reset, wifi_var_get, wifi_var_set

    config WIFI_CFG_ENABLE_WEBUI
        bool "Enable Web UI"
        default n
        help
            Enable embedded Web UI for WiFi Config.
            Serves responsive web interface at root path (/).
            Files are compressed with gzip (~10KB total).

    config WIFI_CFG_WEBUI_CUSTOM_PATH
        string "Custom Web UI path (filesystem)"
        default ""
        depends on WIFI_CFG_ENABLE_WEBUI
        help
            Optional path to custom Web UI files on LittleFS/SPIFFS.
            If set, files from this path will be served instead of
            embedded defaults. Leave empty to use embedded Web UI.
            Example: "/littlefs" or "/spiffs"

    menu "Network Provisioning (BLE)"

        config WIFI_CFG_ENABLE_NETWORK_PROVISIONING
            bool "Enable ESP-IDF Network/Wi-Fi Provisioning"
            default n
            depends on BT_ENABLED && (BT_BLUEDROID_ENABLED || BT_NIMBLE_ENABLED)
            select BT_NIMBLE_ROLE_PERIPHERAL if BT_NIMBLE_ENABLED
            select BT_NIMBLE_ROLE_BROADCASTER if BT_NIMBLE_ENABLED
            select BT_NIMBLE_GATT_SERVER if BT_NIMBLE_ENABLED
            help
                Enable provisioning via the official ESP-IDF wifi_provisioning
                manager. The library wraps wifi_prov_mgr with the BLE scheme,
                handles credential storage in the multi-network store, and
                exposes a small set of custom protocomm endpoints for
                version/capabilities/variables.

                On ESP-IDF 5.4 this uses the in-tree wifi_provisioning
                component. On ESP-IDF 6.x the implementation is expected to
                migrate to the external `espressif/network_provisioning`
                managed component (see migration notes in MIGRATION.md).

                This replaces the previous custom JSON-over-GATT BLE
                interface (UUID 0xFFE0), which has been removed in this
                release. See the migration guide for instructions on moving
                client tools to the new BLE provisioning protocol.

        config WIFI_CFG_NETWORK_PROVISIONING_BLE
            bool "Use BLE transport (wifi_prov_scheme_ble)"
            default y
            depends on WIFI_CFG_ENABLE_NETWORK_PROVISIONING
            help
                Use the BLE transport scheme for the wifi_provisioning manager.
                Currently the only transport supported by this library; SoftAP
                provisioning is provided separately by the existing captive
                portal flow.

    endmenu

    menu "Improv WiFi"

        config WIFI_CFG_ENABLE_IMPROV_BLE
            bool "Enable Improv BLE transport"
            default n
            depends on BT_ENABLED && (BT_BLUEDROID_ENABLED || BT_NIMBLE_ENABLED)
            depends on !WIFI_CFG_ENABLE_NETWORK_PROVISIONING
            select BT_NIMBLE_ROLE_PERIPHERAL if BT_NIMBLE_ENABLED
            select BT_NIMBLE_ROLE_BROADCASTER if BT_NIMBLE_ENABLED
            select BT_NIMBLE_GATT_SERVER if BT_NIMBLE_ENABLED
            help
                Enable the Improv WiFi BLE transport. Registers a GATT service
                (UUID 00467768-...) for provisioning via Web Bluetooth or the
                ESPHome companion app.
                Reference: https://www.improv-wifi.com/

                Mutually exclusive with WIFI_CFG_ENABLE_NETWORK_PROVISIONING:
                only one BLE provisioning protocol can own the BLE host /
                advertising at a time. Pick the one that matches your
                provisioning client tooling.

        config WIFI_CFG_ENABLE_IMPROV_SERIAL
            bool "Enable Improv Serial transport"
            default n
            depends on !WIFI_CFG_ENABLE_CLI
            help
                Enable the Improv WiFi Serial transport over UART.
                Uses the Improv Serial framing protocol.
                Reference: https://www.improv-wifi.com/

                Independent of BLE — safe to enable alongside Network
                Provisioning BLE.

                Mutually exclusive with WIFI_CFG_ENABLE_CLI: both want to
                own the console UART (the CLI prints human-readable
                output via esp_console while Improv Serial frames binary
                bytes on the same stream), so only one can be active.

        config WIFI_MGR_IMPROV_SERIAL_UART_NUM
            int "Improv Serial UART port number"
            default 0
            depends on WIFI_CFG_ENABLE_IMPROV_SERIAL
            help
                UART port number used for Improv Serial transport.
                0 = UART0, 1 = UART1, 2 = UART2.

        config WIFI_MGR_IMPROV_SERIAL_BAUD
            int "Improv Serial baud rate"
            default 115200
            depends on WIFI_CFG_ENABLE_IMPROV_SERIAL
            help
                Baud rate for the Improv Serial UART transport.

    endmenu

endmenu
```

## examples/with_ble/sdkconfig.defaults
```kconfig
CONFIG_IDF_TARGET="esp32s3"

# Larger partition table for BLE (requires 4MB+ flash)
CONFIG_PARTITION_TABLE_SINGLE_APP_LARGE=y

# BLE Configuration
CONFIG_BT_ENABLED=y
# Network Provisioning works on both Bluedroid and NimBLE.
# NimBLE is recommended (smaller footprint, default for IDF 5.x targets):
CONFIG_BT_NIMBLE_ENABLED=y
CONFIG_BT_NIMBLE_HOST_TASK_STACK_SIZE=6144
# To use Bluedroid instead, replace the two lines above with:
#   CONFIG_BT_BLUEDROID_ENABLED=y
#   CONFIG_BT_CLASSIC_ENABLED=n
#   CONFIG_BT_BLE_42_FEATURES_SUPPORTED=y

# Use ESP-IDF's official Network Provisioning over BLE.
# Runtime parameters (security version, PoP, device name, reset-on-failure,
# etc.) now live in wifi_cfg_prov_config_t — see main.c.
CONFIG_WIFI_CFG_ENABLE_NETWORK_PROVISIONING=y
CONFIG_WIFI_CFG_NETWORK_PROVISIONING_BLE=y
```

## examples/with_ble_deinit/sdkconfig.defaults
```kconfig
CONFIG_IDF_TARGET="esp32s3"

# Use larger partition table for BLE (requires 4MB+ flash)
CONFIG_PARTITION_TABLE_SINGLE_APP_LARGE=y

# BLE Configuration — NimBLE (lighter than Bluedroid)
CONFIG_BT_ENABLED=y
CONFIG_BT_NIMBLE_ENABLED=y
CONFIG_BT_NIMBLE_HOST_TASK_STACK_SIZE=6144

# Use Improv BLE so the host-stack handoff pattern that this example
# demonstrates (deinit library, keep NimBLE alive, register app GATT
# service) is exercised end-to-end. Network Provisioning manages its own
# BLE lifecycle and is a poor fit for this particular example.
CONFIG_WIFI_CFG_ENABLE_IMPROV_BLE=y
```

## examples/with_cli/sdkconfig.defaults
```kconfig
CONFIG_IDF_TARGET="esp32s3"

# Enable WiFi Config CLI
CONFIG_WIFI_CFG_ENABLE_CLI=y

# ESP Console settings
CONFIG_ESP_CONSOLE_USB_SERIAL_JTAG=y
```

## examples/with_improv/sdkconfig.defaults
```kconfig
CONFIG_IDF_TARGET="esp32s3"

# Use larger partition table for BLE (requires 4MB+ flash)
CONFIG_PARTITION_TABLE_SINGLE_APP_LARGE=y

# BLE Configuration
CONFIG_BT_ENABLED=y
# For BLE, choose ONE host stack:
#   Bluedroid (default, ~100KB flash / ~40KB RAM):
CONFIG_BT_BLUEDROID_ENABLED=y
CONFIG_BT_CLASSIC_ENABLED=n
CONFIG_BT_BLE_42_FEATURES_SUPPORTED=y
#   Or NimBLE (lighter, ~50KB flash / ~20KB RAM):
#     CONFIG_BT_NIMBLE_ENABLED=y
#     CONFIG_BT_NIMBLE_HOST_TASK_STACK_SIZE=6144

# WiFi Manager BLE (custom GATT protocol)
CONFIG_WIFI_CFG_ENABLE_BLE=y

# Improv WiFi (standard protocol)
CONFIG_WIFI_CFG_ENABLE_IMPROV_BLE=y
# Uncomment to also enable Improv Serial over UART:
# CONFIG_WIFI_CFG_ENABLE_IMPROV_SERIAL=y
# CONFIG_WIFI_CFG_IMPROV_SERIAL_UART_NUM=0
# CONFIG_WIFI_CFG_IMPROV_SERIAL_BAUD=115200

# Move WiFi RX/TX IRAM functions to flash to free IRAM
CONFIG_ESP_WIFI_IRAM_OPT=n
CONFIG_ESP_WIFI_RX_IRAM_OPT=n
```

## examples/with_webui/sdkconfig.defaults
```kconfig
CONFIG_IDF_TARGET="esp32s3"

# Enable WiFi Config Web UI
CONFIG_WIFI_CFG_ENABLE_WEBUI=y
```

## examples/with_webui_customize/sdkconfig.defaults
```kconfig
CONFIG_IDF_TARGET="esp32s3"

# Enable WiFi Config Web UI with custom path
CONFIG_WIFI_CFG_ENABLE_WEBUI=y
CONFIG_WIFI_CFG_WEBUI_CUSTOM_PATH="/littlefs"

# Partition table
CONFIG_PARTITION_TABLE_CUSTOM=y
CONFIG_PARTITION_TABLE_CUSTOM_FILENAME="partitions.csv"
```
